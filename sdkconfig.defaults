## sdkconfig.defaults
```kconfig
CONFIG_BT_ENABLED=y
CONFIG_BT_NIMBLE_ENABLED=y
CONFIG_BT_NIMBLE_ROLE_PERIPHERAL=y
CONFIG_BT_NIMBLE_MAX_CONNECTIONS=1
CONFIG_BT_NIMBLE_EXT_ADV=n
CONFIG_BT_CTRL_MODEM_SLEEP=y
CONFIG_BT_NIMBLE_SVC_GAP_DEVICE_NAME="PagerBridge"
CONFIG_ESP_WIFI_ENABLED=n
CONFIG_ESPTOOLPY_FLASHSIZE_8MB=y
CONFIG_ESPTOOLPY_FLASHSIZE="8MB"

# Arduino as ESP-IDF component needs an `app_main` entrypoint.
# Enabling autostart makes Arduino provide it and run `setup()`/`loop()`.
CONFIG_AUTOSTART_ARDUINO=y

# Power management (the whole point)
CONFIG_PM_ENABLE=y
CONFIG_FREERTOS_HZ=1000
CONFIG_FREERTOS_USE_TICKLESS_IDLE=y
CONFIG_FREERTOS_USE_TRACE_FACILITY=y
CONFIG_FREERTOS_GENERATE_RUN_TIME_STATS=y
CONFIG_FREERTOS_RUN_TIME_STATS_USING_ESP_TIMER=y
CONFIG_USJ_NO_AUTO_LS_ON_CONNECTION=y

# Required by Arduino WiFiClientSecure to avoid PSK warning in ssl_client.cpp.
CONFIG_MBEDTLS_PSK_MODES=y
CONFIG_MBEDTLS_KEY_EXCHANGE_PSK=y
CONFIG_MBEDTLS_KEY_EXCHANGE_DHE_PSK=y
CONFIG_MBEDTLS_KEY_EXCHANGE_ECDHE_PSK=y
CONFIG_MBEDTLS_KEY_EXCHANGE_RSA_PSK=y
```
